// dactyl_endgame_left.overlay

#include "dactyl_endgame.dtsi" // Notice that the main dtsi files are included in the overlay.

&kscan0 {
    col-gpios
        = <&gpio0 10 GPIO_ACTIVE_HIGH> // col5 in the schematic
        , <&gpio0 16 GPIO_ACTIVE_HIGH> // col4 in the schematic
        , <&gpio1 14 GPIO_ACTIVE_HIGH> // col3 in the schematic
        , <&gpio0 15 GPIO_ACTIVE_HIGH> // col2 in the schematic
        , <&gpio1 18 GPIO_ACTIVE_HIGH> // col1 in the schematic
        , <&gpio1 19 GPIO_ACTIVE_HIGH> // col0 in the schematic
        , <&gpio1 20 GPIO_ACTIVE_HIGH> // col0 in the schematic
        ;
};
