## config/boards/shields/dactyl_cc/Kconfig.shield
```kconfig
config SHIELD_DACTYL_CC_LEFT
    def_bool $(shields_list_contains,dactyl_endgame_left)

config SHIELD_DACTYL_CC_RIGHT
    def_bool $(shields_list_contains,dactyl_endgame_right)

config ZMK_SLEEP
    default y

config ZMK_IDLE_SLEEP_TIMEOUT
    default 600000
```
